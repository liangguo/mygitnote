## arch/powerpc/platforms/xenon/Kconfig
```kconfig
config PPC_XENON
	bool "Xenon"
	depends on PPC64
	select PPC_NATIVE
	default y
	help
	  This option enables support for the Xbox 360 game console
	  without a hypervisor.
```
